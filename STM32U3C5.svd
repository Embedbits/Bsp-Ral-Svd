# STM32U3C5 register map
File version: 1.0
CPU: CM33 r0p1, little endian, MPU, FPU, 4 interrupt priority bits
Registers are 32-bit, read-write, reset 0x0 unless marked. A register's access mark holds for its fields unless they carry their own. Offsets are from the block's base; lines under a group give offsets from that group; [hi:lo] are bit positions; {n}, {i} and the like mark numbered series; 'fields as' and 'values as' point back to an identical list; <NAME> marks a mode.

## Memory map
0x40000000 TIM2 size 0x3E4 — TIM2 address block description
0x40000400 TIM3 size 0x3E4 — TIM3 address block description
0x40000800 TIM4 size 0x3E4 — TIM4 address block description
0x40001000 TIM6 size 0x30 — TIM6 address block description
0x40001400 TIM7 size 0x30 — TIM7 address block description
0x40002000 SPI3 size 0x50
0x40002400 SPI4 size 0x50
0x40002C00 WWDG size 0xC — WWDG address block description
0x40003000 IWDG size 0x18 — IWDG address block description
0x40003800 SPI2 size 0x50
0x40004400 USART2 size 0x34
0x40004800 USART3 size 0x34
0x40004C00 UART4 size 0x34
0x40005000 UART5 size 0x34
0x40005400 I2C1 size 0x30 — I2C1 address block description
0x40005800 I2C2 size 0x30
0x40005C00 I3C1 size 0x400 — I3C register block
0x40006000 CRS size 0x10 — CRS address block description
0x40007000 OPAMP size 0x400 — OPAMP Address block
0x40007400 VREFBUF size 0x8 — VREFBUF address block description
0x40007800 RTC size 0x400 — RTC register block
0x40007C00 TAMP size 0x400 — TAMP register block
0x40008400 I2C4 size 0x30
0x40009400 LPTIM2 size 0x400 — LPTIM2 Address block
0x4000A400 FDCAN1 size 0x400 — FDCAN register block
0x4000A800 FDCAN2 size 0x400
0x40012C00 TIM1 size 0x3E4 — TIM1 address block description
0x40013000 SPI1 size 0x50 — SPI address block description
0x40013400 TIM8 size 0x3E4
0x40013800 USART1 size 0x34 — USART1 address block description
0x40013C00 TIM12 size 0x60 — TIM12 address block description
0x40014000 TIM15 size 0x3E4 — TIM15 address block description
0x40014400 TIM16 size 0x3E4 — TIM16 address block description
0x40014800 TIM17 size 0x3E4 — TIM17 address block description
0x40015400 SAI size 0x400 — SAI register block
0x40016000 USB size 0x400 — USB Address block
0x40016400 USBSRAM size 0x400 — USBSRAM Address block
0x40016C00 I3C2 size 0x400
0x40020000 GPDMA1 size 0x1000
0x40022000 FLASH size 0x400 — FLASH register block
0x40023000 CRC size 0x18 — CRC address block description
0x40024000 TSC size 0x50 — TSC address block description
0x40026000 RAMCFG size 0x400 — RAMCFG register block
0x4002C000 HSP size 0x400 — HSP register block
0x40030400 ICACHE size 0x400 — ICACHE register block
0x40030800 PWR size 0x400 — PWR register block
0x40030C00 RCC size 0x400 — RCC register block
0x40032000 EXTI size 0x400 — EXTI register block
0x40032400 GTZC1_TZSC size 0x250 — GTZC1_TZSC address block description
0x40032800 GTZC1_TZIC size 0x250 — GTZC1_TZIC address block description
0x40032C00 GTZC1_MPCBB1 size 0x250 — GTZC1_MPCBB1 address block description
0x40033000 GTZC1_MPCBB2 size 0x250 — GTZC1_MPCBB2 address block description
0x40033400 GTZC1_MPCBB3 size 0x250 — GTZC1_MPCBB3 address block description
0x40033800 GTZC1_MPCBB4 size 0x250 — GTZC1_MPCBB4 address block description
0x40034000 ADF size 0x400 — ADF register block
0x40040400 SYSCFG size 0x400 — SYSCFG register block
0x40042400 LPUART size 0x34 — LPUART address block description
0x40042800 I2C3 size 0x30
0x40044400 LPTIM1 size 0x400 — LPTIM1 Address block
0x40044800 LPTIM3 size 0x400 — LPTIM3 Address block
0x40044C00 LPTIM4 size 0x400 — LPTIM4 Address block
0x40045400 COMP size 0x400 — COMP1 Address block
0x42020000 GPIOA size 0x34 — GPIOA address block description
0x42020400 GPIOB size 0x34 — GPIOB address block description
0x42020800 GPIOC size 0x34 — GPIOC address block description
0x42020C00 GPIOD size 0x34 — GPIOD address block description
0x42021000 GPIOE size 0x34 — GPIOE address block description
0x42021400 GPIOF size 0x34 — GPIOF address block description
0x42021800 GPIOG size 0x34 — GPIOG address block description
0x42021C00 GPIOH size 0x34 — GPIOH address block description
0x42028000 ADC1 size 0x100 — ADC register block
0x42028100 ADC2 size 0x100
0x42028300 ADC12 size 0x14 — ADC12 address block description
0x42028400 DAC size 0x400 — DAC Address block
0x420C0000 AES size 0x400 — AES register block
0x420C0400 HASH size 0x400 — HASH register bank
0x420C0800 RNG size 0x20 — RNG address block description
0x420C0C00 SAES size 0x400 — SAES register block
0x420C2000 PKA size 0x2000 — PKA register blank and RAM
0x420C7C00 CCB size 0x400 — CCB register block
0x420C8000 SDMMC1 size 0xC0 — SDMMC1 address block description
0x420C8400 DLYBSD1 size 0x400 — DLYB Address block
0x420CF000 DLYBOS1 size 0x400
0x420D1400 OCTOSPI size 0x400 — OCTOSPI register block
0x50000000 SEC_TIM2 size 0x3E4
0x50000400 SEC_TIM3 size 0x3E4
0x50000800 SEC_TIM4 size 0x3E4
0x50001000 SEC_TIM6 size 0x30
0x50001400 SEC_TIM7 size 0x30
0x50002000 SEC_SPI3 size 0x50
0x50002400 SEC_SPI4 size 0x50
0x50002C00 SEC_WWDG size 0xC
0x50003000 SEC_IWDG size 0x18
0x50003800 SEC_SPI2 size 0x50
0x50004400 SEC_USART2 size 0x34
0x50004800 SEC_USART3 size 0x34
0x50004C00 SEC_UART4 size 0x34
0x50005000 SEC_UART5 size 0x34
0x50005400 SEC_I2C1 size 0x30
0x50005800 SEC_I2C2 size 0x30
0x50005C00 SEC_I3C1 size 0x400
0x50006000 SEC_CRS size 0x10
0x50007000 SEC_OPAMP size 0x400
0x50007400 SEC_VREFBUF size 0x8
0x50007800 SEC_RTC size 0x400
0x50007C00 SEC_TAMP size 0x400
0x50008400 SEC_I2C4 size 0x30
0x50009400 SEC_LPTIM2 size 0x400
0x5000A400 SEC_FDCAN1 size 0x400
0x5000A800 SEC_FDCAN2 size 0x400
0x50012C00 SEC_TIM1 size 0x3E4
0x50013000 SEC_SPI1 size 0x50
0x50013400 SEC_TIM8 size 0x3E4
0x50013800 SEC_USART1 size 0x34
0x50013C00 SEC_TIM12 size 0x60
0x50014000 SEC_TIM15 size 0x3E4
0x50014400 SEC_TIM16 size 0x3E4
0x50014800 SEC_TIM17 size 0x3E4
0x50015400 SEC_SAI1 size 0x400
0x50016000 SEC_USB size 0x400
0x50016400 SEC_USBSRAM size 0x400
0x50016C00 SEC_I3C2 size 0x400
0x50020000 SEC_GPDMA1 size 0x1000
0x50022000 SEC_FLASH size 0x400
0x50023000 SEC_CRC size 0x18
0x50024000 SEC_TSC size 0x50
0x50026000 SEC_RAMCFG size 0x400
0x5002C000 HSP_S size 0x400
0x50030400 SEC_ICACHE size 0x400
0x50030800 SEC_PWR size 0x400
0x50030C00 SEC_RCC size 0x400
0x50032000 SEC_ExTI size 0x400
0x50032400 SEC_GTZC1_TZSC size 0x250
0x50032800 SEC_GTZC1_TZIC size 0x250
0x50032C00 SEC_GTZC1_MPCBB1 size 0x250
0x50033000 SEC_GTZC1_MPCBB2 size 0x250
0x50033400 SEC_GTZC1_MPCBB3 size 0x250
0x50033800 SEC_GTZC1_MPCBB4 size 0x250
0x50034000 SEC_ADF size 0x400
0x50040400 SEC_SYSCFG size 0x400
0x50042400 SEC_LPUART size 0x34
0x50042800 SEC_I2C3 size 0x30
0x50044400 SEC_LPTIM1 size 0x400
0x50044800 SEC_LPTIM3 size 0x400
0x50044C00 SEC_LPTIM4 size 0x400
0x50045400 SEC_COMP size 0x400
0x52020000 SEC_GPIOA size 0x34
0x52020400 SEC_GPIOB size 0x34
0x52020800 SEC_GPIOC size 0x34
0x52020C00 SEC_GPIOD size 0x34
0x52021000 SEC_GPIOE size 0x34
0x52021400 SEC_GPIOF size 0x34
0x52021800 SEC_GPIOG size 0x34
0x52021C00 SEC_GPIOH size 0x34
0x52028000 SEC_ADC1 size 0x100
0x52028100 SEC_ADC2 size 0x100
0x52028300 SEC_ADC12 size 0x14
0x52028400 SEC_DAC size 0x400
0x520C0000 SEC_AES size 0x400
0x520C0400 SEC_HASH size 0x400
0x520C0800 SEC_RNG size 0x20
0x520C0C00 SEC_SAES size 0x400
0x520C2000 SEC_PKA size 0x2000
0x520C7C00 SEC_CCB size 0x400
0x520C8000 SEC_SDMMC1 size 0xC0
0x520C8400 SEC_DLYBSD1 size 0x400
0x520CF000 SEC_DLYBOS1 size 0x400
0x520D1400 SEC_OCTOSPI size 0x400
0xE0044000 DBGMCU size 0x1000 — DBGMCU address block description

## Interrupts
0 WWDG — Window Watchdog interrupt
1 PVD_PVM (EXTI) — Programmable voltage detector/peripheral voltage monitor-ExTI16/19/20/21/22
2 RTC — RTC global non-secure interrupts
3 RTC_S (SEC_RTC) — RTC global secure interrupts
4 TAMP — Tamper global interrupts
5 RAMCFG — RAM configuration global interrupt
6 FLASH — Flash non-secure global interrupt
7 FLASH_S (SEC_FLASH) — Flash memory secure global interrupt
8 GTZC (GTZC1_TZSC) — GTZC1/GTZC2 global interrupt
9 RCC — RCC non-secure global interrupt
10 RCC_S (SEC_RCC) — RCC secure global interrupt
{n+11} EXTI{n} (EXTI) (n=0..15) — EXTI Line{n} interrupt
27 IWDG — Independent watchdog interrupt
28 SAES — Secure AES
{n+29} GPDMA1_CHannel{n} (GPDMA1) (n=0..7) — GPDMA1 channel {n} global interrupt
37 ADC1 — ADC1 global interrupt
38 DAC1 (DAC) — DAC1 global interrupt
39 FDCAN1_IT0 (FDCAN1) — FDCAN1 Interrupt 0
40 FDCAN1_IT1 (FDCAN1) — FDCAN1 Interrupt 1
41 TIM1_BRK (TIM1) — TIM1 Break-transition error -index error
42 TIM1_UP (TIM1) — TIM1 Update
43 TIM1_TRG_COM (TIM1) — TIM1 Trigger and Commutation-direction change interrupt -index
44 TIM1_CC (TIM1) — TIM1 Capture Compare interrupt
45 TIM2 — TIM2 global interrupt
46 TIM3 — TIM3 global interrupt
47 TIM4 — TIM4 global interrupt
49 TIM6 — TIM6 global interrupt
50 TIM7 — TIM7 global interrupt
51 TIM12 — TIM12 global interrupt
53 I3C1_ER (I3C1) — I3C1 error interrupt
54 I3C1_EV (I3C1) — I3C1 event interrupt
55 I2C1_EV (I2C1) — I2C1 event interrupt
56 I2C1_ER (I2C1) — I2C1 error interrupt
57 I2C2_EV (I2C2) — I2C2 event interrupt
58 I2C2_ER (I2C2) — I2C2 error interrupt
59 SPI1 — SPI1 global interrupt
60 SPI2 — SPI2 global interrupt
61 USART1 — USART1 global interrupt
62 USART2 — USART2 global interrupt
63 USART3 — USART3 global interrupt
64 UART4 — USART4 global interrupt
65 UART5 — USART5 global interrupt
66 LPUART1 (LPUART) — LPUART1 global interrupt
67 LPTIM1 — LPTIM1 global interrupt
68 LPTIM2 — LPTIM2 global interrupt
69 TIM15 — TIM15 global interrupt
70 TIM16 — TIM16 global interrupt
71 TIM17 — TIM17 global interrupt
72 COMP — COMP1 and COMP2 interrupts
73 USB_FS (USB) — USB FS global interrupt
74 CRS — Clock recovery system global interrupt
76 OCTOSPI1 (OCTOSPI) — OCTOSPI1 global interrupt
77 HSP1 (HSP) — HSP1 global interrupt
78 SDMMC1 — SDMMC1 global interrupt
80 GPDMA1_CHannel8 (GPDMA1) — GPDMA1 channel 8 global interrupt
81 GPDMA1_CHannel9 (GPDMA1) — GPDMA1 channel 9 global interrupt
82 GPDMA1_CHannel10 (GPDMA1) — GPDMA1 channel 10 global interrupt
83 GPDMA1_CHannel11 (GPDMA1) — GPDMA1 channel 11 global interrupt
88 I2C3_EV (I2C3) — I2C3 event interrupt
89 I2C3_ER (I2C3) — I2C3 error interrupt
90 SAI1 (SAI) — SAI1 global interrupt
92 TSC — TSC global interrupt
93 AES — AES global interrupt
94 RNG — RNG global interrupt
95 FPU (EXTI) — Floating point interrupt
96 HASH — HASH interrupt
97 PKA — PKA global interrupt
98 LPTIM3 — LPTIM3 global interrupt
99 SPI3 — SPI3 global interrupt
100 I3C2_ER (I3C2) — I3C2 error interrupt
101 I3C2_EV (I3C2) — I3C2 event interrupt
102 TIM1_BRK_TERR_IERR (TIM8) — TIM8 break_transition error_index error
104 TIM1_TRG_COM_DIR_IDX (TIM8) — TIM8 trigger and commutation_direction change interrupt_index
105 TIM8_CC (TIM8) — TIM8 capture compare interrupt
107 ICACHE — Instruction cache global interrupt
110 LPTIM4 — LPTIM4 global interrupt
112 ADF1 (ADF) — ADF1 interrupt
113 ADC2 — ADC2 global interrupt
114 FDCAN2_IT0 (FDCAN2) — FDCAN2 Interrupt 0
115 FDCAN2_IT1 (FDCAN2) — FDCAN2 Interrupt 1
116 I2C4_EV (I2C4) — I2C4 event interrupt
117 I2C4_ER (I2C4) — I2C4 error interrupt
119 SPI4 — SPI4 global interrupt
123 PWR — PWR non-secure interrupt
124 PWR_S (SEC_PWR) — PWR secure interrupt

## Notices in the file
Copyright (c) 2025 STMicroelectronics.
SPDx-License-Identifier: Apache-2.0
Licensed under the Apache License, Version 2.0 (the "License");
you may not use this file except in compliance with the License.
You may obtain a copy of the License at
http://www.apache.org/licenses/LICENSE-2.0
Unless required by applicable law or agreed to in writing, software
distributed under the License is distributed on an "AS IS" BASIS,
WITHOUT WARRANTIES OR CONDITIONS OF ANY KIND, either express or implied.
See the License for the specific language governing permissions and
limitations under the License.
