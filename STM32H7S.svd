# STM32H7S register map
File version: 1.4
CPU: CM7 r0p1, little endian, MPU, FPU, 4 interrupt priority bits
Registers are 32-bit, read-write, reset 0x0 unless marked. A register's access mark holds for its fields unless they carry their own. Offsets are from the block's base; lines under a group give offsets from that group; [hi:lo] are bit positions; {n}, {i} and the like mark numbered series; 'fields as' and 'values as' point back to an identical list; <NAME> marks a mode.

## Memory map
0x40000000 TIM2 size 0x3E4 — General-purpose timers
0x40000400 TIM3 size 0x3E4 — General-purpose timers
0x40000800 TIM4 size 0x3E4 — General-purpose timers
0x40000C00 TIM5 size 0x3E4 — General-purpose timers
0x40001000 TIM6 size 0x30 — Basic timers
0x40001400 TIM7 size 0x30 — Basic timers
0x40001800 TIM12 size 0x60 — General-purpose timers
0x40001C00 TIM13 size 0x60 — General-purpose timers
0x40002000 TIM14 size 0x60 — General-purpose timers
0x40002400 LPTIM1 size 0xC — Low power timer
0x40002C00 WWDG size 0x400
0x40003800 SPI2 size 0x400
0x40003C00 SPI3 size 0x400
0x40004000 SPDIFRX size 0x1C — SPDIF receiver interface
0x40004400 USART2 size 0x400
0x40004800 USART3 size 0x400
0x40004C00 UART4 size 0x400
0x40005000 UART5 size 0x400
0x40005400 I2C1_I3C1 size 0x400 — Inter-integrated circuit
0x40005800 I2C2 size 0x400
0x40005C00 I2C3 size 0x400
0x40006C00 CEC size 0x18 — HDMI-CEC controller
0x40007800 UART7 size 0x400
0x40007C00 UART8 size 0x400
0x40008400 CRS size 0x400 — Clock Recovery System
0x40009400 MDIOS size 0x400 — Management data input/output
0x4000A000 FDCAN1 size 0x400
0x4000A400 FDCAN2 size 0x400
0x4000EC00 UCPD size 0x400 — USB Type-C/USB Power Delivery interface
0x40021000 GPDMA size 0x1000 — General purpose direct memory access controller
0x40022000 ADC1 size 0xCC — ADC register block
0x40022100 ADC2 size 0xCC
0x40022300 ADC12_common size 0x400 — master and slave ADC common
0x40028000 ETH size 0x11F0 — Ethernet register block
0x4002F000 ADF size 0xF4 — Audio digital filter
0x40040000 OTG_HS size 0xE08 — OTG register block
0x40080000 OTG_FS size 0xE08
0x42000000 TIM1 size 0x3E4 — Advanced-control timers
0x42001000 USART1 size 0x400 — Universal synchronous/asynchronous receiver transmitter
0x42003000 SPI1 size 0x400 — Serial peripheral interface
0x42003400 SPI4 size 0x400
0x42004000 TIM15 size 0x3E4 — General purpose timers
0x42004400 TIM16 size 0x3E4 — General purpose timers
0x42004800 TIM17 size 0x3E4 — General purpose timers
0x42004C00 TIM9 size 0x60 — General-purpose timers
0x42005000 SPI5 size 0x400
0x42005800 SAI1 size 0x400 — Serial audio interface
0x42005C00 SAI2 size 0x400
0x48000400 PSSI size 0x400 — Parallel synchronous slave interface
0x48002400 SDMMC2 size 0x400
0x48002800 DLYB2 size 0x400
0x48004400 CORDIC size 0x100 — CORDIC register block
0x48020000 RNG size 0x400 — True random number generator
0x48020400 HASH size 0x400 — Hash processor
0x48020800 CRYP size 0x400 — Cryptographic processor
0x48021000 SAES size 0x400 — Secure AES coprocessor
0x48022000 PKA size 0x4000 — Public key accelerator
0x50001000 LTDC size 0x148 — LTDC register block
0x50002000 DCMIPP size 0x1000 — Digital camera interface pixel pipeline
0x50004000 GFXTIM size 0x400 — Graphic timer
0x52000000 HPDMA size 0x1000 — High-performance direct memory access controller
0x52001000 DMA2D size 0xC00 — Chrom-Art Accelerator controller
0x52002000 FLASH size 0x1000 — Embedded Flash memory
0x52003000 JPEG size 0x8BC — JPEG codec
0x52004000 FMC size 0x15C — Flexible memory controller
0x52005000 XSPI1 size 0x22C — XSPI register block
0x52007000 SDMMC1 size 0x400 — Secure digital input/output MultiMediaCard interface
0x52008000 DLYB1 size 0x400 — DLYB register block
0x52009000 ECC_DIAG_D1 size 0x1000 — RAMECC1 configuration controller
0x5200A000 XSPI2 size 0x22C
0x5200B400 XSPIM1 size 0x20 — XSPIM1 register block
0x5200B800 MCE1 size 0x400 — Memory cipher engine
0x5200BC00 MCE2 size 0x400
0x5200C000 MCE3 size 0x400
0x52010000 GFXMMU size 0x3000 — Chrom-GRC
0x52015000 ICACHE size 0x400 — Texture cache
0x58000000 EXTI size 0x400 — Extended interrupt and event controller
0x58000400 SBS size 0x140 — System configuration, boot and security
0x58000C00 LPUART1 size 0x30 — Low-power universal asynchronous receiver transmitter
0x58001400 SPI6 size 0x400
0x58002400 LPTIM2 size 0xC — Low power timer
0x58002800 LPTIM3 size 0xC — Low power timer
0x58002C00 LPTIM4 size 0xC — Low power timer
0x58003000 LPTIM5 size 0xC — Low power timer
0x58003C00 VREFBUF size 0x8 — Voltage reference buffer
0x58004000 RTC size 0x400 — RTC register block
0x58004400 TAMP size 0x400 — TAMP register block
0x58004800 IWDG size 0x400 — IWDG register block
0x58006800 DTS size 0x400 — Digital temperature sensor
0x58020000 GPIOA size 0x30 — General-purpose I/Os
0x58020400 GPIOB size 0x30 — General-purpose I/Os
0x58020800 GPIOC size 0x30 — General-purpose I/Os
0x58020C00 GPIOD size 0x30 — General-purpose I/Os
0x58021000 GPIOE size 0x30 — General-purpose I/Os
0x58021400 GPIOF size 0x30 — General-purpose I/Os
0x58021800 GPIOG size 0x30 — General-purpose I/Os
0x58021C00 GPIOH size 0x30 — General-purpose I/Os
0x58023000 GPIOM size 0x30 — General-purpose I/Os
0x58023400 GPION size 0x30 — General-purpose I/Os
0x58023800 GPIOO size 0x30 — General-purpose I/Os
0x58023C00 GPIOP size 0x30 — GPIOP address block description
0x58024400 RCC size 0x184 — RCC register block
0x58024800 PWR size 0x54 — Power control
0x58024C00 CRC size 0x18 — Cyclic redundancy check calculation unit
0x58027000 ECC_DIAG_D2 size 0x1000 — RAMECC2 configuration controller
0x5C001000 DBGMCU size 0x1000 — Microcontroller debug unit

## Interrupts
0 PVD_AVD (EXTI) — PVD and AVD through the EXTI line
2 DTS — DTS global interrupt
3 IWDG — Independent watchdog interrupt
4 WWDG — Window Watchdog interrupt
5 RCC — RCC global interrupt
6 LOOKUP (EXTI) — LOOKUP/Overstack
7 CACHE_ECC (EXTI) — Error ECC cache
8 FLASH — Flash memory
9 ECC_FPU (EXTI) — ECC/FPU/ All flag from exec
10 FPU (EXTI) — FPU safety Flag
13 TAMP — RTC tamper and timestamp interrupts through the EXTI line
{n+16} EXTI{n} (EXTI) (n=0..15) — EXTI Line {n} interrupt through the EXTI line
32 RTC — RTC Wakeup and Alarm interrupt through the EXTI line
33 SAES — SAES global interrupt
34 AES (SAES) — AES global interrupt
35 PKA — PKA global interrupt
36 HASH — HASH global interrupt
37 RNG — RNG global interrupt
38 ADC1_2 (ADC12_common) — ADC1/2 global interrupt
{n+39} GPDMA1_CH{n} (GPDMA) (n=0..7) — GPDMA1 channel {n} interrupt
47 TIM1_BRK (TIM1) — TIM1 Break interrupt
48 TIM1_UP (TIM1) — TIM1 Update interrupt (tim_upd_it)
49 TIM1_TRG_COM (TIM1) — TIM1 Trigger and Commutation interrupts
50 TIM1_CC (TIM1) — TIM1 Capture Compare interrupt
51 TIM2 — TIM2 global interrupt
52 TIM3 — TIM3 global interrupt
53 TIM4 — TIM4 global interrupt
54 TIM5 — TIM5 global interrupt
55 TIM6 — TIM6 global interrupt
56 TIM7 — TIM7 global interrupt
57 TIM9 — TIM9 global interrupt
58 SPI1 — SPI1 global interrupt
59 SPI2 — SPI2 global interrupt
60 SPI3 — SPI3 global interrupt
61 SPI4 — SPI4 global interrupt
62 SPI5 — SPI5 global interrupt
63 SPI6 — SPI6 global interrupt
{n+64} HPDMA1_CH{n} (HPDMA) (n=0..7) — HPDMA1 channel {n} interrupt
72 SAI1_A (SAI1) — SAI1 global interrupt A
73 SAI1_B (SAI1) — SAI1 global interrupt B
74 SAI2_A (SAI2) — SAI2 global interrupt A
75 SAI2_B (SAI2) — SAI2 global interrupt B
76 I2C1_EV (I2C1_I3C1) — I2C1 event interrupt
77 I2C1_ER (I2C1_I3C1) — I2C1 error interrupt
78 I2C2_EV (I2C2) — I2C2 event interrupt
79 I2C2_ER (I2C2) — I2C2 error interrupt
80 I2C3_EV (I2C3) — I2C3 event interrupt
81 I2C3_ER (I2C3) — I2C3 error interrupt
82 USART1 — USART1 global interrupt
83 USART2 — USART2 global interrupt
84 USART3 — USART3 global interrupt
85 UART4 — UART4 global interrupt
86 UART5 — UART5 global interrupt
87 UART7 — UART7 global interrupt
88 UART8 — UART8 global interrupt
89 I3C1_EV (I2C1_I3C1) — I3C1 event interrupt
90 I3C1_ER (I2C1_I3C1) — I3C1 error interrupt
91 OTG_HS — USB OTG HS global interrupt
92 ETH — Ethernet global interrupt
93 CORDIC — CORDIC interrupt
94 GFXTIM — GFXTIM global interrupt
95 DCMIPP — DCMIPP global interrupt
96 LTDC — LCD global interrupt
97 LTDC_ER (LTDC) — LCD error interrupt
98 DMA2D — DMA2D global interrupt
99 JPEG — JPEG global interrupt
100 GFXMMU — GFXMMU global interrupt
101 I3C1_WKUP (I2C1_I3C1) — I3C wakeup Interrupt through EXTI line
102 MCE1 — MCE1 global interrupt
103 MCE2 — MCE2 global interrupt
104 MCE3 — MCE3 global interrupt
105 OSPI1 (XSPI1) — OSPI1 / HSPI1 global interrupt
106 OSPI2 (XSPI1) — OSPI2 global interrupt
107 FMC — FMC global interrupt
108 SDMMC1 — SDMMC1 global interrupt
109 SDMMC2 — SDMMC2 global interrupt
112 OTG_FS — USB OTG FS global interrupt
113 TIM12 — TIM12 global interrupt
114 TIM13 — TIM13 global interrupt
115 TIM14 — TIM14 global interrupt
116 TIM15 — TIM15 global interrupt
117 TIM16 — TIM16 global interrupt
118 TIM17 — TIM17 global interrupt
119 LPTIM1 — LPTIM1 global interrupt
120 LPTIM2 — LPTIM2 global interrupt
121 LPTIM3 — LPTIM3 global interrupt
122 LPTIM4 — LPTIM4 global interrupt
123 LPTIM5 — LPTIM5 global interrupt
124 SPDIF_RX (SPDIFRX) — SPDIFRX global interrupt
125 MDIOS — MDIOS global interrupt
126 ADF1_FLT0 (ADF) — ADF1 filter 0 global interrupt
127 CRS — CRS global interrupt
128 UCPD1 (UCPD) — UCPD global interrupt
129 CEC — CEC global interrupt
130 PSSI — PSSI global interrupt
131 LPUART1 — LPUART1 LPUART1 global interrupt
132 WAKEUP_PIN (EXTI) — Interrupt for 4 wakeup pins (1, 2, 3, 4)through EXTI line
{n+125} GPDMA1_CH{n} (GPDMA) (n=8..15) — GPDMA1 channel {n} interrupt
{n+133} HPDMA1_CH{n} (HPDMA) (n=8..15) — HPDMA1 channel {n} interrupt
149 GPU2D (GPDMA) — GPU2D global interrupt
150 GPU2D_ER (GPDMA) — GPU2D error interrupt
151 TCACHE (GPDMA) — GPU cache interrupt
152 FDCAN1_IT0 (FDCAN1) — FDCAN1 Interrupt 0
153 FDCAN1_IT1 (FDCAN1) — FDCAN1 Interrupt 1
154 FDCAN2_IT0 (FDCAN2) — FDCAN2 Interrupt 0
155 FDCAN2_IT1 (FDCAN2) — FDCAN2 Interrupt 1

## Notices in the file
Copyright (c) 2026 STMicroelectronics.
SPDX-License-Identifier: Apache-2.0
Licensed under the Apache License, Version 2.0 (the "License");
you may not use this file except in compliance with the License.
You may obtain a copy of the License at
http://www.apache.org/licenses/LICENSE-2.0
Unless required by applicable law or agreed to in writing, software
distributed under the License is distributed on an "AS IS" BASIS,
WITHOUT WARRANTIES OR CONDITIONS OF ANY KIND, either express or implied.
See the License for the specific language governing permissions and
limitations under the License.
