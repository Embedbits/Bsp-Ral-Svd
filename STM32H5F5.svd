# STM32H5F5 register map
File version: 1.0
CPU: CM33 r0p0, little endian, MPU, FPU, 4 interrupt priority bits
Registers are 32-bit, read-write, reset 0x0 unless marked. A register's access mark holds for its fields unless they carry their own. Offsets are from the block's base; lines under a group give offsets from that group; [hi:lo] are bit positions; {n}, {i} and the like mark numbered series; 'fields as' and 'values as' point back to an identical list; <NAME> marks a mode.

## Memory map
0x40000000 TIM2 size 0x3E4 — TIM2 address block description
0x40000400 TIM3 size 0x3E4 — TIM3 address block description
0x40000800 TIM4 size 0x3E4 — TIM4 address block description
0x40000C00 TIM5 size 0x3E4 — TIM5 address block description
0x40001000 TIM6 size 0x30 — TIM6 address block description
0x40001400 TIM7 size 0x30 — TIM7 address block description
0x40001800 TIM12 size 0x60 — TIM12 address block description
0x40001C00 TIM13 size 0x60 — TIM13 address block description
0x40002000 TIM14 size 0x60 — TIM14 address block description
0x40002C00 WWDG size 0xC — WWDG address block description
0x40003000 IWDG size 0x18 — IWDG address block description
0x40003400 OPAMP1 size 0xC — OPAMP1 address block description
0x40003800 SPI2 size 0x54
0x40003C00 SPI3 size 0x54
0x40004000 COMP size 0x400 — COMP register block
0x40004400 USART2 size 0x30
0x40004800 USART3 size 0x30
0x40004C00 UART4 size 0x30
0x40005000 UART5 size 0x30
0x40005400 I2C1 size 0x2C — I2C1 address block description
0x40005800 I2C2 size 0x2C
0x40005C00 I3C1 size 0x400 — I3C1 register block
0x40006000 CRS size 0x10 — CRS address block description
0x40006400 USART6 size 0x30
0x40006800 USART10 size 0x30
0x40006C00 USART11 size 0x30
0x40007000 CEC size 0x18 — CEC address block description
0x40007800 UART7 size 0x30
0x40007C00 UART8 size 0x30
0x40008000 UART9 size 0x30
0x40008400 UART12 size 0x30
0x40008C00 DTS size 0x30 — DTS address block description
0x40009400 LPTIM2 size 0x38 — LPTIM2 address block description
0x4000A000 FDCAN3 size 0x400
0x4000A400 FDCAN1 size 0x400 — FDCAN1 register block
0x4000A800 FDCAN2 size 0x400
0x4000DC00 UCPD size 0x400 — UCPD register block
0x40012C00 TIM1 size 0x3E4 — TIM1 address block description
0x40013000 SPI size 0x54 — SPI address block description
0x40013400 TIM8 size 0x3E4 — TIM8 address block description
0x40013800 USART1 size 0x30 — USART1 address block description
0x40014000 TIM15 size 0x3E4 — TIM15 address block description
0x40014400 TIM16 size 0x3E4 — TIM16 address block description
0x40014800 TIM17 size 0x3E4 — TIM17 address block description
0x40014C00 SPI4 size 0x54
0x40015000 SPI6 size 0x54
0x40015400 SAI1 size 0x400 — SAI1 register block
0x40015800 SAI2 size 0x400
0x40016C00 LTDC size 0x148 — LTDC address block description
0x40017400 GFXTIM size 0x400 — GFXTIM register block
0x40020000 GPDMA size 0x1000 — GPDMA register block
0x40021000 GPDMA2 size 0x1000
0x40022000 FLASH size 0x400 — FLASH register block
0x40023000 CRC size 0x18 — CRC address block description
0x40023800 CORDIC size 0x400 — CORDIC register block
0x40023C00 FMAC size 0x400 — FMAC register block
0x40025000 MDF size 0x1000 — MDF register block
0x40026000 RAMCFG size 0x400 — RAMCFG register block
0x40028000 ETH size 0x1168 — ETH address block description
0x4002A000 DMA2D size 0xC00 — DMA2D address block description
0x4002B000 JPEG size 0x800 — JPEG address block description
0x40030400 ICACHE size 0x400 — ICACHE register block
0x40031400 DCACHE size 0x400 — DCACHE register block
0x40032400 GTZC1_TZSC size 0x80 — GTZC1_MPCBBz register block
0x40032800 GTZC1_TZIC size 0x30 — GTZC1_MPCBBz register block
0x40032C00 GTZC1_MPCBB1 size 0x280 — GTZC1_MPCBB1 address block description
0x40033000 GTZC1_MPCBB2 size 0x280 — GTZC1_MPCBB2 address block description
0x40033400 GTZC1_MPCBB3 size 0x280 — GTZC1_MPCBB3 address block description
0x42020000 GPIOA size 0x34 — GPIOA address block description
0x42020400 GPIOB size 0x34 — GPIOB address block description
0x42020800 GPIOC size 0x34 — GPIOC address block description
0x42020C00 GPIOD size 0x34 — GPIOD address block description
0x42021000 GPIOE size 0x34 — GPIOE address block description
0x42021400 GPIOF size 0x34 — GPIOF address block description
0x42021800 GPIOG size 0x34 — GPIOG address block description
0x42021C00 GPIOH size 0x34 — GPIOH address block description
0x42022000 GPIOI size 0x34 — GPIOI address block description
0x42022400 GPIOJ size 0x34 — GPIOJ address block description
0x42022800 GPIOK size 0x34 — GPIOK address block description
0x42028000 ADC size 0x400 — ADC register block
0x42028400 DAC size 0x50 — DAC address block description
0x4202C000 DCMI size 0x2C — DCMI address block description
0x4202C400 PSSI size 0x400 — PSSI register block
0x4202C800 ADF size 0x1000 — ADF register block
0x4202D800 ADC3 size 0x400
0x42040000 OTG_HS size 0xE08 — OTG_HS address block description
0x42080000 OTG_FS size 0xE08 — OTG_FS address block description
0x420C0000 AES size 0x400 — AES register block
0x420C0400 HASH size 0x400 — HASH register bank
0x420C0800 RNG size 0x20 — RNG address block description
0x420C0C00 SAES size 0x400
0x420C2000 PKA size 0x2000 — PKA register blank and RAM
0x420C7C00 CCB size 0x400 — CCB register block
0x44000400 SBS size 0x158 — SBS address block description
0x44002000 SPI5 size 0x54
0x44002400 LPUART1 size 0x30 — LPUART1 address block description
0x44002800 I2C3 size 0x2C
0x44002C00 I2C4 size 0x2C
0x44003000 I3C2 size 0x400
0x44004400 LPTIM1 size 0x38 — LPTIM1 address block description
0x44004800 LPTIM3 size 0x38 — LPTIM3 address block description
0x44004C00 LPTIM4 size 0x2C — LPTIM4 address block description
0x44005000 LPTIM5 size 0x38 — LPTIM5 address block description
0x44005400 LPTIM6 size 0x38 — LPTIM6 address block description
0x44007400 VREFBUF size 0x8 — VREFBUF address block description
0x44007800 RTC size 0x400 — RTC register block
0x44007C00 TAMP size 0x400 — TAMP register block
0x44008000 PLAY size 0x400 — PLAY register block
0x44020800 PWR size 0x108 — PWR address block description
0x44020C00 RCC size 0x400 — RCC register block
0x44022000 EXTI size 0xA8 — EXTI address block description
0x44024000 DBGMCU size 0x1000 — DBGMCU register block
0x46005000 OTFDEC1 size 0x400 — OTFDEC1 register bank
0x46005400 OTFDEC2 size 0x400
0x46008000 SDMMC1 size 0xC0 — SDMMC1 address block description
0x46008400 DLYBSD1 size 0x8
0x46008800 DLYBSD2 size 0x8
0x46008C00 SDMMC2 size 0xC0
0x4600F000 DLYBOS1 size 0x8 — DLYBOS1 address block description
0x4600F400 DLYBOS2 size 0x8
0x47000400 FMC size 0x15C — FMC address block description
0x47001400 OCTOSPI1 size 0x400 — OCTOSPI1 register block
0x47002400 OCTOSPI2 size 0x400
0x47003400 OCTOSPIM size 0x400 — OCTOSPIM register block
0x50000000 TIM2_S size 0x3E4
0x50000400 TIM3_S size 0x3E4
0x50000800 TIM4_S size 0x3E4
0x50000C00 TIM5_S size 0x3E4
0x50001000 TIM6_S size 0x30
0x50001400 TIM7_S size 0x30
0x50001800 TIM12_S size 0x60
0x50001C00 TIM13_S size 0x60
0x50002000 TIM14_S size 0x60
0x50002C00 WWDG_S size 0xC
0x50003000 IWDG_S size 0x18
0x50003400 OPAMP1_S size 0xC
0x50003800 SPI2_S size 0x54
0x50003C00 SPI3_S size 0x54
0x50004000 COMP_S size 0x400
0x50004400 USART2_S size 0x30
0x50004800 USART3_S size 0x30
0x50004C00 UART4_S size 0x30
0x50005000 UART5_S size 0x30
0x50005400 I2C1_S size 0x2C
0x50005800 I2C2_S size 0x2C
0x50005C00 I3C1_S size 0x400
0x50006000 CRS_S size 0x10
0x50006400 USART6_S size 0x30
0x50006800 USART10_S size 0x30
0x50006C00 USART11_S size 0x30
0x50007000 CEC_S size 0x18
0x50007800 UART7_S size 0x30
0x50007C00 UART8_S size 0x30
0x50008000 UART9_S size 0x30
0x50008400 UART12_S size 0x30
0x50008C00 DTS_S size 0x30
0x50009400 LPTIM2_S size 0x38
0x5000A000 FDCAN3_S size 0x400
0x5000A400 FDCAN1_S size 0x400
0x5000A800 FDCAN2_S size 0x400
0x5000DC00 UCPD_S size 0x400
0x50012C00 TIM1_S size 0x3E4
0x50013000 SPI_S size 0x54
0x50013400 TIM8_S size 0x3E4
0x50013800 USART1_S size 0x30
0x50014000 TIM15_S size 0x3E4
0x50014400 TIM16_S size 0x3E4
0x50014800 TIM17_S size 0x3E4
0x50014C00 SPI4_S size 0x54
0x50015000 SPI6_S size 0x54
0x50015400 SAI1_S size 0x400
0x50015800 SAI2_S size 0x400
0x50016C00 LTDC_S size 0x148
0x50017400 GFXTIM_S size 0x400
0x50020000 GPDMA_S size 0x1000
0x50021000 GPDMA2_S size 0x1000
0x50022000 FLASH_S size 0x400
0x50023000 CRC_S size 0x18
0x50023800 CORDIC_S size 0x400
0x50023C00 FMAC_S size 0x400
0x50025000 MDF_S size 0x1000
0x50026000 RAMCFG_S size 0x400
0x50028000 ETH_S size 0x1168
0x5002A000 DMA2D_S size 0xC00
0x5002B000 JPEG_S size 0x800
0x50030400 ICACHE_S size 0x400
0x50031400 DCACHE_S size 0x400
0x50032400 GTZC1_TZSC_S size 0x80
0x50032800 GTZC1_TZIC_S size 0x30
0x50032C00 GTZC1_MPCBB1_S size 0x280
0x50033000 GTZC1_MPCBB2_S size 0x280
0x50033400 GTZC1_MPCBB3_S size 0x280
0x52020000 GPIOA_S size 0x34
0x52020400 GPIOB_S size 0x34
0x52020800 GPIOC_S size 0x34
0x52020C00 GPIOD_S size 0x34
0x52021000 GPIOE_S size 0x34
0x52021400 GPIOF_S size 0x34
0x52021800 GPIOG_S size 0x34
0x52021C00 GPIOH_S size 0x34
0x52022000 GPIOI_S size 0x34
0x52022400 GPIOJ_S size 0x34
0x52022800 GPIOK_S size 0x34
0x52028000 ADC_S size 0x400
0x52028400 DAC_S size 0x50
0x5202C000 DCMI_S size 0x2C
0x5202C400 PSSI_S size 0x400
0x5202C800 ADF_S size 0x1000
0x5202D800 ADC3_S size 0x400
0x52040000 OTG_HS_S size 0xE08
0x52080000 OTG_FS_S size 0xE08
0x520C0000 AES_S size 0x400
0x520C0400 HASH_S size 0x400
0x520C0800 RNG_S size 0x20
0x520C0C00 SAES_S size 0x400
0x520C2000 PKA_S size 0x2000
0x520C7C00 CCB_S size 0x400
0x54000400 SBS_S size 0x158
0x54002000 SPI5_S size 0x54
0x54002400 LPUART1_S size 0x30
0x54002800 I2C3_S size 0x2C
0x54002C00 I2C4_S size 0x2C
0x54003000 I3C2_S size 0x400
0x54004400 LPTIM1_S size 0x38
0x54004800 LPTIM3_S size 0x38
0x54004C00 LPTIM4_S size 0x2C
0x54005000 LPTIM5_S size 0x38
0x54005400 LPTIM6_S size 0x38
0x54007400 VREFBUF_S size 0x8
0x54007800 RTC_S size 0x400
0x54007C00 TAMP_S size 0x400
0x54008000 PLAY_S size 0x400
0x54020800 PWR_S size 0x108
0x54020C00 RCC_S size 0x400
0x54022000 EXTI_S size 0xA8
0x54024000 DBGMCU_S size 0x1000
0x56005000 OTFDEC1_S size 0x400
0x56005400 OTFDEC2_S size 0x400
0x56008000 SDMMC1_S size 0xC0
0x56008400 DLYBSD1_S size 0x8
0x56008800 DLYBSD2_S size 0x8
0x56008C00 SDMMC2_S size 0xC0
0x5600F000 DLYBOS1_S size 0x8
0x5600F400 DLYBOS2_S size 0x8
0x57000400 FMC_S size 0x15C
0x57001400 OCTOSPI1_S size 0x400
0x57002400 OCTOSPI2_S size 0x400
0x57003400 OCTOSPIM_S size 0x400

## Interrupts
0 WWDG — Window Watchdog interrupt
1 PVD_AVD (PWR) — Power Voltage Monitor/Analog Voltage Monitor
2 RTC — RTC global non-secure interrupts
3 RTC_S (RTC) — RTC global secure interrupts
4 TAMP — Tamper global interrupts
5 RAMCFG — RAM configuration global interrupt
6 FLASH — Flash non-secure global interrupt
7 FLASH_S — Flash secure global interrupt
8 GTZC1 (GTZC1_TZSC) — GTZC global interrupt
9 RCC — RCC non-secure global interrupt
10 RCC_S — RCC secure global interrupt
{n+11} EXTI{n} (EXTI) (n=0..15) — EXTI Line{n} interrupt
{n+27} GPDMA1_CH{n} (GPDMA) (n=0..7) — GPDMA1 channel{n} global interrupt
35 IWDG — Independent watchdog interrupt
36 SAES — Secure AES
37 ADC1 (ADC) — ADC1 global interrupt
38 DAC1 (DAC) — DAC1 global interrupt
39 FDCAN1_IT0 (FDCAN1) — FDCAN1 Interrupt 0
40 FDCAN1_IT1 (FDCAN1) — FDCAN1 Interrupt 1
41 TIM1_BRK_TIM1_TERR_TIM1_IERR (TIM1) — TIM1 Break/TIM1 Transition error/TIM1 Index error
42 TIM1_UP (TIM1) — TIM1 Update
43 TIM1_TRG_COM_TIM1_DIR_TIM1_IDX (TIM1) — TIM1 trigger and commutation/TIM1 Direction Change interrupt/TIM1 Index
44 TIM1_CC (TIM1) — TIM1 capture compare interrupt
45 TIM2 — TIM2 global interrupt
46 TIM3 — TIM3 global interrupt
47 TIM4 — TIM4 global interrupt
48 TIM5 — TIM5 global interrupt
49 TIM6 — TIM6 global interrupt
50 TIM7 — TIM7 global interrupt
51 I2C1_EV (I2C1) — I2C1 event interrupt
52 I2C1_ER (I2C1) — I2C1 error interrupt
53 I2C2_EV (I2C2) — I2C2 event interrupt
54 I2C2_ER (I2C2) — I2C2 error interrupt
55 SPI1 (SPI) — SPI1 global interrupt
56 SPI2 — SPI2 global interrupt
57 SPI3 — SPI3 global interrupt
58 USART1 — USART1 global interrupt
59 USART2 — USART2 global interrupt
60 USART3 — USART3 global interrupt
61 UART4 — UART4 global interrupt
62 UART5 — UART5 global interrupt
63 LPUART1 — LPUART1 global interrupt OR LPUART1 R Wakeup OR LPUART1 T Wakeup Char(10)through EXTI line
64 LPTIM1_OR_LPTIM1_AIT (LPTIM1) — LPTIM1 global interrupt OR LPTimer1 AIT through EXTI line
65 TIM8_BRK_TIM8_TERR_TIM8_IERR (TIM8) — TIM8 Break interrupt/TIM8 Transition error/TIM8 Index error
66 TIM8_UP (TIM8) — TIM8 Update interrupt
67 TIM8_TRG_COM_TIM8_DIR_TIM8_IDX (TIM8) — TIM8 trigger and commutation interrupt/TIM8 Direction Change interrupt/TIM8 Index
68 TIM8_CC (TIM8) — TIM8 capture compare interrupt
69 ADC2 (ADC) — ADC2 global interrupt
70 LPTIM2_OR_LPTIM2_AIT (LPTIM2) — LPTIM2 global interrupt OR LPTimer2 AIT through EXTI line
71 TIM15 — TIM15 global interrupt
72 TIM16 — TIM16 global interrupt
73 TIM17 — TIM17 global interrupt
74 OTG_FS — USB OTG FS global interrupt
75 CRS — Clock Recovery System global interrupt
76 UCPD1 (UCPD) — UCPD1 global interrupt
77 FMC — FMC global interrupt
78 OCTOSPI1 — OCTOSPI1 global interrupt
79 SDMMC1 — SDMMC1 global interrupt
80 I2C3_EV (I2C3) — I2C3 event interrupt
81 I2C3_ER (I2C3) — I2C3 error interrupt
82 SPI4 — SPI4 global interrupt
83 SPI5 — SPI5 global interrupt
84 SPI6 — SPI6 global interrupt
85 USART6 — USART6 global interrupt
86 USART10 — USART10 global interrupt
87 USART11 — USART11 global interrupt
88 SAI1 — SAI1 global interrupt
89 SAI2 — SAI2 global interrupt
90 GPDMA2_CH0 (GPDMA2) — GPDMA2 channel0 global interrupt
91 GPDMA2_CH1 (GPDMA2) — GPDMA2 channel1 global interrupt
92 GPDMA2_CH2 (GPDMA2) — GPDMA2 channel2 global interrupt
93 GPDMA2_CH3 (GPDMA2) — GPDMA2 channe3 global interrupt
94 GPDMA2_CH4 (GPDMA2) — GPDMA2 channel4 global interrupt
95 GPDMA2_CH5 (GPDMA2) — GPDMA2 channel5 global interrupt
96 GPDMA2_CH6 (GPDMA2) — GPDMA2 channel6 global interrupt
97 GPDMA2_CH7 (GPDMA2) — GPDMA2 channel7 global interrupt
98 UART7 — UART7 global interrupt
99 UART8 — UART8 global interrupt
100 UART9 — UART9 global interrupt
101 UART12 — UART12 global interrupt
102 SDMMC2 — SDMMC2 global interrupt
103 FPU (GPDMA2) — Floating point interrupt
104 ICACHE — Instruction cache global interrupt
105 DCACHE — Data cache global interrupt
106 ETH — Ethernet interrupt
107 ETH_WKUP (ETH) — ETHERNET Wakeup interrupt through EXTI line
108 DCMI_PSSI (DCMI) — DCMI/PSSI global interrupt
109 FDCAN2_IT0 (FDCAN2) — FDCAN2 Interrupt 0
110 FDCAN2_IT1 (FDCAN2) — FDCAN2 Interrupt 1
111 CORDIC — CORDIC interrupt
112 FMAC — FMAC interrupt
113 DTS_OR_DTS_WKUP (DTS) — DTS interrupt OR DTS AIT through EXTI line
114 RNG — RNG global interrupt
115 OTFDEC1 — OTFDEC1 secure global interrupt
116 AES — AES global interrupt
117 HASH — HASH interrupt
118 PKA — PKA global interrupt
119 CEC — HDMI-CEC global interrupt
120 TIM12 — TIM12 global interrupt
121 TIM13 — TIM13 global interrupt
122 TIM14 — TIM14 global interrupt
123 I3C1_EV (I3C1) — I3C1 event interrupt
124 I3C1_ER (I3C1) — I3C1 error interrupt
125 I2C4_EV (I2C4) — I2C4 event interrupt
126 I2C4_ER (I2C4) — I2C4 error interrupt
127 LPTIM3_OR_LPTIM3_AIT (LPTIM3) — LPTIM3 global interrupt OR LPTimer3 AIT through EXTI line
128 LPTIM4_OR_LPTIM4_AIT (LPTIM4) — LPTIM4 global interrupt OR LPTimer4 AIT through EXTI line
129 LPTIM5_OR_LPTIM5_AIT (LPTIM5) — LPTIM5 global interrupt OR LPTimer5 AIT through EXTI line
130 LPTIM6_OR_LPTIM6_AIT (LPTIM6) — LPTIM6 global interrupt OR LPTimer6 AIT through EXTI line
131 I3C2_EV (I3C2) — I3C2 event interrupt
132 I3C2_ER (I3C2) — I3C2 error interrupt
133 COMP — Comparator global interrupt
134 DMA2D — DMA2D interrupt
135 JPEG — JPEG interrupt
136 GPDMA1_CH8 (GPDMA) — GPDMA1 channel8 global interrupt
137 GPDMA1_CH9 (GPDMA) — GPDMA1 channel9 global interrupt
138 GPDMA1_CH10 (GPDMA) — GPDMA1 channel10 global interrupt
139 GPDMA1_CH11 (GPDMA) — GPDMA1 channel11 global interrupt
140 GPDMA2_CH8 (GPDMA2) — GPDMA2 channel8 global interrupt
141 GPDMA2_CH9 (GPDMA2) — GPDMA2 channel9 global interrupt
142 GPDMA2_CH10 (GPDMA2) — GPDMA2 channel10 global interrupt
143 GPDMA2_CH11 (GPDMA2) — GPDMA2 channel11 global interrupt
144 GFXTIM — GFXTIM interrupt
145 LCD_IRQ (LTDC) — LCD interrupt
146 LCD_GBL_ERROR (LTDC) — LCD global error
149 ADC3 — ADC3 global interrupt
150 OCTOSPI2 — OCTOSPI2 global interrupt
151 OTFDEC2 — OTFDEC2 secure global interrupt
152 FDCAN3_IT0 (FDCAN3) — FDCAN3 Interrupt 0
153 FDCAN3_IT1 (FDCAN3) — FDCAN3 Interrupt 1
154 MDF1_FLT0 (MDF) — MDF1 Filter 0 global interrupt
155 MDF1_FLT1 (MDF) — MDF1 Filter 1 global interrupt
156 MDF1_FLT2 (MDF) — MDF1 Filter 2 global interrupt
157 MDF1_FLT3 (MDF) — MDF1 Filter 3 global interrupt
158 MDF1_FLT4 (MDF) — MDF1 Filter 4 global interrupt
159 MDF1_FLT5 (MDF) — MDF1 Filter 5 global interrupt
160 ADF1 (ADF) — ADF1 interrupt
161 OTG_HS — USB OTG HS global interrupt

## Notices in the file
Copyright (c) 2025 STMicroelectronics.
SPDX-License-Identifier: Apache-2.0
Licensed under the Apache License, Version 2.0 (the "License");
you may not use this file except in compliance with the License.
You may obtain a copy of the License at
http://www.apache.org/licenses/LICENSE-2.0
Unless required by applicable law or agreed to in writing, software
distributed under the License is distributed on an "AS IS" BASIS,
WITHOUT WARRANTIES OR CONDITIONS OF ANY KIND, either express or implied.
See the License for the specific language governing permissions and
limitations under the License.
