# STM32H573 register map
File version: 1.7
CPU: CM33 r0p0, little endian, MPU, FPU, 4 interrupt priority bits
Registers are 32-bit, read-write, reset 0x0 unless marked. A register's access mark holds for its fields unless they carry their own. Offsets are from the block's base; lines under a group give offsets from that group; [hi:lo] are bit positions; {n}, {i} and the like mark numbered series; 'fields as' and 'values as' point back to an identical list; <NAME> marks a mode.

## Memory map
0x40000000 TIM2 size 0x400 — General-purpose timers
0x40000400 TIM3 size 0x400 — General-purpose timers
0x40000800 TIM4 size 0x400 — General-purpose timers
0x40000C00 TIM5 size 0x400 — General-purpose timers
0x40001000 TIM6 size 0x400 — Basic timers
0x40001400 TIM7 size 0x400 — Basic timers
0x40001800 TIM12 size 0x400 — General-purpose timers
0x40001C00 TIM13 size 0x400 — General-purpose timers
0x40002000 TIM14 size 0x400 — General-purpose timers
0x40002C00 WWDG size 0x400 — System window watchdog
0x40003000 IWDG size 0x400 — Independent watchdog
0x40003800 SPI2 size 0x400
0x40003C00 SPI3 size 0x400
0x40004400 USART2 size 0x400
0x40004800 USART3 size 0x400
0x40004C00 UART4 size 0x400
0x40005000 UART5 size 0x400
0x40005400 I2C1 size 0x400 — Inter-integrated circuit
0x40005800 I2C2 size 0x400
0x40005C00 I3C size 0x400 — Improved inter-integrated circuit
0x40006000 CRS size 0x400 — Clock recovery system
0x40006400 USART6 size 0x400
0x40006800 USART10 size 0x400
0x40006C00 USART11 size 0x400
0x40007800 UART7 size 0x400
0x40007C00 UART8 size 0x400
0x40008000 UART9 size 0x400
0x40008400 UART12 size 0x400
0x40008C00 DTS size 0x400 — Digital temperature sensor
0x40009400 LPTIM2 size 0x400
0x4000A400 FDCAN1 size 0x400 — Controller area network
0x4000A800 FDCAN2 size 0x400
0x4000DC00 UCPD1 size 0x400 — USB Power Delivery interface
0x40012C00 TIM1 size 0x400 — Advanced-control timers
0x40013000 SPI1 size 0x400 — Serial peripheral interface
0x40013400 TIM8 size 0x400 — Advanced-control timers
0x40013800 USART1 size 0x400 — Universal synchronous asynchronous receiver transmitter
0x40014000 TIM15 size 0x400 — TIM15 address block description
0x40014400 TIM16 size 0x400 — TIM16 address block description
0x40014800 TIM17 size 0x400 — TIM17 address block description
0x40014C00 SPI4 size 0x400
0x40015000 SPI6 size 0x400
0x40015400 SAI1 size 0x400 — Serial audio interface
0x40015800 SAI2 size 0x400
0x40016000 USB size 0x400 — USB full speed
0x40020000 GPDMA1 size 0x1000 — General purpose direct memory access controller
0x40021000 GPDMA2 size 0x1000
0x40022000 FLASH size 0x400 — FLASH address block description
0x40023000 CRC size 0x400 — Cyclic redundancy check calculation unit
0x40023800 CORDIC size 0x400 — CORDIC Co-processor
0x40023C00 FMAC size 0x400 — Filter Math Accelerator
0x40026000 RAMCFG size 0x400 — RAMs configuration controller
0x40028000 ETH size 0x11F0 — Ethernet media access control
0x40030400 ICACHE size 0x400 — Instruction cache
0x40031400 DCACHE size 0x400 — Data cache
0x40032400 GTZC1_TZSC size 0x400 — Global TrustZone controller
0x40032800 GTZC1_TZIC size 0x400
0x40032C00 GTZC1_MPCBB1 size 0x400
0x40033000 GTZC1_MPCBB2 size 0x400
0x40033400 GTZC1_MPCBB3 size 0x400
0x42020000 GPIOA size 0x400 — General-purpose I/Os
0x42020400 GPIOB size 0x400 — General-purpose I/Os
0x42020800 GPIOC size 0x400 — General-purpose I/Os
0x42020C00 GPIOD size 0x400
0x42021000 GPIOE size 0x400
0x42021400 GPIOF size 0x400
0x42021800 GPIOG size 0x400
0x42021C00 GPIOH size 0x400 — General-purpose I/Os
0x42022000 GPIOI size 0x400 — General-purpose I/Os
0x42028000 ADC1 size 0xCC — Analog to digital converter
0x42028100 ADC2 size 0xCC
0x42028300 ADCC size 0x100 — ADC common registers block
0x42028400 DAC size 0x50 — Digital to analog converter
0x4202C000 DCMI size 0x400 — Digital camera interface
0x4202C400 PSSI size 0x400 — Parallel synchronous slave interface
0x420C0000 AES size 0x400 — Advanced encryption standard hardware accelerator
0x420C0400 HASH size 0x400 — HASH register bank
0x420C0800 RNG size 0x400 — True random number generator
0x420C0C00 SAES size 0x400 — Secure advanced encryption standard hardware accelerator
0x420C2000 PKA size 0x2000 — Private key accelerator
0x44000400 SBS size 0x400 — SBS register block
0x44002000 SPI5 size 0x400
0x44002400 LPUART size 0x400 — Universal synchronous asynchronous receiver transmitter
0x44002800 I2C3 size 0x400
0x44002C00 I2C4 size 0x400
0x44004400 LPTIM1 size 0x400 — Low power timer
0x44004800 LPTIM3 size 0x400
0x44004C00 LPTIM4 size 0x400
0x44005000 LPTIM5 size 0x400
0x44005400 LPTIM6 size 0x400
0x44007400 VREFBUF size 0x400 — Voltage reference buffer
0x44007800 RTC size 0x400 — Real-time clock
0x44007C00 TAMP size 0x400 — Tamper and backup
0x44020800 PWR size 0x400 — Power control
0x44020C00 RCC size 0x400 — Reset and clock controller
0x44022000 EXTI size 0x400 — Extended interrupt and event controller
0x44024000 DBGMCU size 0x1000 — Microcontroller debug unit
0x46005000 OTFDEC1 size 0x400 — On-The-Fly Decryption engine
0x46008000 SDMMC1 size 0x400 — Secure digital input/output MultiMediaCard interface
0x46008400 DLYBSD1 size 0x400
0x46008800 DLYBSD2 size 0x400
0x46008C00 SDMMC2 size 0x400
0x4600F000 DLYBOS1 size 0x400 — Delay block
0x47000400 FMC size 0x15C — Flexible memory controller
0x47001400 OCTOSPI size 0x400 — Octo-SPI interface
0x50000000 SEC_TIM2 size 0x400
0x50000400 SEC_TIM3 size 0x400
0x50000800 SEC_TIM4 size 0x400
0x50000C00 SEC_TIM5 size 0x400
0x50001000 SEC_TIM6 size 0x400
0x50001400 SEC_TIM7 size 0x400
0x50001800 SEC_TIM12 size 0x400
0x50001C00 SEC_TIM13 size 0x400
0x50002000 SEC_TIM14 size 0x400
0x50002C00 SEC_WWDG size 0x400
0x50003000 SEC_IWDG size 0x400
0x50003800 SEC_SPI2 size 0x400
0x50003C00 SEC_SPI3 size 0x400
0x50004400 SEC_USART2 size 0x400
0x50004800 SEC_USART3 size 0x400
0x50004C00 SEC_UART4 size 0x400
0x50005000 SEC_UART5 size 0x400
0x50005400 SEC_I2C1 size 0x400
0x50005800 SEC_I2C2 size 0x400
0x50005C00 SEC_I3C size 0x400
0x50006000 SEC_CRS size 0x400
0x50006400 SEC_USART6 size 0x400
0x50006800 SEC_USART10 size 0x400
0x50006C00 SEC_USART11 size 0x400
0x50007800 SEC_UART7 size 0x400
0x50007C00 SEC_UART8 size 0x400
0x50008000 SEC_UART9 size 0x400
0x50008400 SEC_UART12 size 0x400
0x50008C00 SEC_DTS size 0x400
0x50009400 SEC_LPTIM2 size 0x400
0x5000A400 SEC_FDCAN1 size 0x400
0x5000A800 SEC_FDCAN2 size 0x400
0x5000DC00 SEC_UCPD1 size 0x400
0x50012C00 SEC_TIM1 size 0x400
0x50013000 SEC_SPI1 size 0x400
0x50013400 SEC_TIM8 size 0x400
0x50013800 SEC_USART1 size 0x400
0x50014000 SEC_TIM15 size 0x400
0x50014400 SEC_TIM16 size 0x400
0x50014800 SEC_TIM17 size 0x400
0x50014C00 SEC_SPI4 size 0x400
0x50015000 SEC_SPI6 size 0x400
0x50015400 SEC_SAI1 size 0x400
0x50015800 SEC_SAI2 size 0x400
0x50016000 SEC_USB size 0x400
0x50020000 SEC_GPDMA1 size 0x1000
0x50021000 SEC_GPDMA2 size 0x1000
0x50022000 SEC_FLASH size 0x400
0x50023000 SEC_CRC size 0x400
0x50023800 SEC_CORDIC size 0x400
0x50023C00 SEC_FMAC size 0x400
0x50026000 SEC_RAMCFG size 0x400
0x50028000 SEC_ETH size 0x11F0
0x50030400 SEC_ICACHE size 0x400
0x50031400 SEC_DCACHE size 0x400
0x50032400 SEC_GTZC1_TZSC size 0x400
0x50032800 SEC_GTZC1_TZIC size 0x400
0x50032C00 SEC_GTZC1_MPCBB1 size 0x400
0x50033000 SEC_GTZC1_MPCBB2 size 0x400
0x50033400 SEC_GTZC1_MPCBB3 size 0x400
0x52020000 SEC_GPIOA size 0x400
0x52020400 SEC_GPIOB size 0x400
0x52020800 SEC_GPIOC size 0x400
0x52020C00 SEC_GPIOD size 0x400
0x52021000 SEC_GPIOE size 0x400
0x52021400 SEC_GPIOF size 0x400
0x52021800 SEC_GPIOG size 0x400
0x52021C00 SEC_GPIOH size 0x400
0x52022000 SEC_GPIOI size 0x400
0x52028000 SEC_ADC1 size 0xCC
0x52028100 SEC_ADC2 size 0xCC
0x52028300 SEC_ADCC size 0x100
0x52028400 SEC_DAC size 0x50
0x5202C000 SEC_DCMI size 0x400
0x5202C400 SEC_PSSI size 0x400
0x520C0000 SEC_AES size 0x400
0x520C0400 SEC_HASH size 0x400
0x520C0800 SEC_RNG size 0x400
0x520C0C00 SEC_SAES size 0x400
0x520C2000 SEC_PKA size 0x2000
0x54000400 SEC_SBS size 0x400
0x54002000 SEC_SPI5 size 0x400
0x54002400 SEC_LPUART1 size 0x400
0x54002800 SEC_I2C3 size 0x400
0x54002C00 SEC_I2C4 size 0x400
0x54004400 SEC_LPTIM1 size 0x400
0x54004800 SEC_LPTIM3 size 0x400
0x54004C00 SEC_LPTIM4 size 0x400
0x54005000 SEC_LPTIM5 size 0x400
0x54005400 SEC_LPTIM6 size 0x400
0x54007400 SEC_VREFBUF size 0x400
0x54007800 SEC_RTC size 0x400
0x54007C00 SEC_TAMP size 0x400
0x54020800 SEC_PWR size 0x400
0x54020C00 SEC_RCC size 0x400
0x54022000 SEC_EXTI size 0x400
0x56005000 SEC_OTFDEC1 size 0x400
0x56008000 SEC_SDMMC1 size 0x400
0x56008400 SEC_DLYBSD1 size 0x400
0x56008800 SEC_DLYBSD2 size 0x400
0x56008C00 SEC_SDMMC2 size 0x400
0x5600F000 SEC_DLYBOS1 size 0x400
0x57000400 SEC_FMC size 0x15C
0x57001400 SEC_OCTOSPI size 0x400

## Interrupts
0 WWDG — Window Watchdog interrupt
4 TAMP — TAMP global interrupt
5 RAMCFG — RAM configuration global interrupt
6 FLASH — FLASH non-secure global interrupt
7 FLASH_S (FLASH) — FLASH secure global interrupt
8 GTZC (GTZC1_TZSC) — GTZC global interrupt
9 RCC — RCC non-secure global interrupt
10 RCC_S (RCC) — RCC secure global interrupt
{n+11} EXTI{n} (EXTI) (n=0..15) — EXTI Line{n} interrupt
{n+27} GPDMA1_CH{n} (GPDMA1) (n=0..7) — GPDMA1 channel {n} global interrupt
35 IWDG — IWDG interrupt
36 SAES — secure AES interrupt
37 ADC1 — ADC1 global interrupt
38 DAC1 (DAC) — DAC1 global interrupt
39 FDCAN1_IT0 (FDCAN1) — FDCAN1 interrupt 0
40 FDCAN1_IT1 (FDCAN1) — FDCAN1 interrupt 1
41 TIM1_BRK_TERR_IERR (TIM1) — TIM1 break/TIM1 transition error/TIM1 index error
42 TIM1_UP (TIM1) — TIM1 Update
43 TIM1_TRG_COM_DIR_IDX (TIM1) — TIM1 trigger and commutation/TIM1 direction change interrupt/TIM1 index
44 TIM1_CC (TIM1) — TIM1 capture compare interrupt
45 TIM2 — TIM2 global interrupt
46 TIM3 — TIM3 global interrupt
47 TIM4 — TIM4 global interrupt
48 TIM5 — TIM5 global interrupt
49 TIM6 — TIM6 global interrupt
50 TIM7 — TIM7 global interrupt
51 I2C1_EV (I2C1) — I2C1 event interrupt
52 I2C1_ER (I2C1) — I2C1 error interrupt
53 I2C2_EV (I2C2) — I2C2 event interrupt
54 I2C2_ER (I2C2) — I2C2 error interrupt
55 SPI1 — SPI1 global interrupt
56 SPI2 — SPI2 global interrupt
57 SPI3 — SPI3 global interrupt
58 USART1 — USART1 global interrupt
59 USART2 — USART2 global interrupt
60 USART3 — USART3 global interrupt
61 UART4 — UART4 global interrupt
62 UART5 — UART5 global interrupt
63 LPUART1 (LPUART) — LPUART1 global interrupt
64 LPTIM1 — LPTIM1 global interrupt
65 IM8_BRK_TERR_IERR (TIM8) — TIM8 break interrupt/TIM8 transition error/TIM8 index error
66 TIM8_UP (TIM8) — TIM8 update interrupt
67 TIM8_TRG_COM_DIR_IDX (TIM8) — TIM8 trigger and commutation interrupt/TIM8 direction change interrupt/TIM8 index
68 TIM8_CC (TIM8) — TIM8 capture compare interrupt
69 ADC2 — ADC2 global interrupt
70 LPTIM2 — LPTIM2 global interrupt
71 TIM15 — TIM5 global interrupt
72 TIM16 — TIM6 global interrupt
73 TIM17 — TIM17 global interrupt
74 USB_FS (USB) — USB OTG FS global interrupt
75 CRS — Clock Recovery System global interrupt
76 UCPD1 — UCPD1 global interrupt
77 FMC — FMC global interrupt
78 OCTOSPI1 (OCTOSPI) — OCTOSPI1 global interrupt
79 SDMMC1 — SDMMC1 global interrupt
80 I2C3_EV (I2C3) — I2C3 event interrupt
81 I2C3_ER (I2C3) — I2C3 error interrupt
82 SPI4 — SPI4 global interrupt
83 SPI5 — SPI5 global interrupt
84 SPI6 — SPI6 global interrupt
85 USART6 — USART6 global interrupt
86 USART10 — USART10 global interrupt
87 USART11 — USART11 global interrupt
88 SAI1 — SAI1 global interrupt
89 SAI2 — SAI2 global interrupt
{n+90} GPDMA2_CH{n} (GPDMA2) (n=0..7) — GPDMA2 channel {n} global interrupt
98 UART7 — UART7 global interrupt
99 UART8 — UART8 global interrupt
100 UART9 — UART9 global interrupt
101 UART12 — UART12 global interrupt
102 SDMMC2 — SDMMC2 global interrupt
104 ICACHE — Instruction cache global interrupt
105 DCACHE — Data cache global interrupt
106 ETH — ETH interrupt
107 ETH_WKUP (ETH) — ETHERNET wakeup interrupt through EXTI line
108 DCMI_PSSI (DCMI) — DCMI/PSSI global interrupt
109 FDCAN2_IT0 (FDCAN2) — FDCAN2 interrupt 0
110 FDCAN2_IT1 (FDCAN2) — FDCAN2 interrupt 1
111 Cordic (CORDIC) — Cordic interrupt
112 FMAC — FMAC interrupt
113 DTS_WKUP (DTS) — DTS interrupt or DTS AIT through EXTI line
114 RNG — RNG global interrupt
115 OTFDEC1 — OTFDEC1 secure global interrupt
116 AES — AES global interrupt
117 HASH — HASH interrupt
118 PKA — PKA global interrupt
120 TIM12 — TIM12 global interrupt
121 TIM13 — TIM13 global interrupt
122 TIM14 — TIM14 global interrupt
123 I3C1_EV (I3C) — I3C1 event interrupt
124 I3C1_ER (I3C) — I3C1 error interrupt
125 I2C4_EV (I2C4) — I2C4 event interrupt
126 I2C4_ER (I2C4) — I2C4 error interrupt
127 LPTIM3 — LPTIM3 global interrupt
128 LPTIM4 — LPTIM4 global interrupt
129 LPTIM5 — LPTIM5 global interrupt
130 LPTIM6 — LPTIM6 global interrupt

## Notices in the file
Copyright (c) 2025 STMicroelectronics.
SPDX-License-Identifier: Apache-2.0
Licensed under the Apache License, Version 2.0 (the "License");
you may not use this file except in compliance with the License.
You may obtain a copy of the License at
http://www.apache.org/licenses/LICENSE-2.0
Unless required by applicable law or agreed to in writing, software
distributed under the License is distributed on an "AS IS" BASIS,
WITHOUT WARRANTIES OR CONDITIONS OF ANY KIND, either express or implied.
See the License for the specific language governing permissions and
limitations under the License.
